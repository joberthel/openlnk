## esp32/examples/dos_client_idf/main/Kconfig.projbuild
```kconfig
menu "OpenLNK MS-DOS Client Configuration"

    menu "RS-232 / MAX3232 UART Settings"
        config OPENLNK_CLIENT_UART_PORT
            int "UART port number"
            range 0 2
            default 1
            help
                Hardware UART peripheral wired to the MAX3232 RS-232 transceiver.
                Keep UART0 free for USB console logging.

        config OPENLNK_CLIENT_UART_TX_GPIO
            int "UART TX GPIO (to MAX3232 T1IN)"
            range 0 48
            default 17 if IDF_TARGET_ESP32 || IDF_TARGET_ESP32S2 || IDF_TARGET_ESP32S3
            default 4
            help
                GPIO connected to MAX3232 T1IN (3.3V TTL TX).

        config OPENLNK_CLIENT_UART_RX_GPIO
            int "UART RX GPIO (from MAX3232 R1OUT)"
            range 0 48
            default 16 if IDF_TARGET_ESP32
            default 18 if IDF_TARGET_ESP32S2 || IDF_TARGET_ESP32S3
            default 5
            help
                GPIO connected to MAX3232 R1OUT (3.3V TTL RX).

        config OPENLNK_CLIENT_UART_HW_FLOW_CTRL
            bool "Enable RTS/CTS hardware flow control"
            default n
            help
                Standard MS-DOS INTERLNK uses 3-wire null-modem cabling (TX/RX/GND)
                with in-band echo pacing. Leave disabled unless your MAX3232 and
                PC serial cable wire RTS/CTS.

        config OPENLNK_CLIENT_UART_RTS_GPIO
            int "UART RTS GPIO"
            depends on OPENLNK_CLIENT_UART_HW_FLOW_CTRL
            range -1 48
            default -1

        config OPENLNK_CLIENT_UART_CTS_GPIO
            int "UART CTS GPIO"
            depends on OPENLNK_CLIENT_UART_HW_FLOW_CTRL
            range -1 48
            default -1

        choice OPENLNK_CLIENT_MAX_BAUD_CHOICE
            prompt "Maximum negotiated baud rate"
            default OPENLNK_CLIENT_MAX_BAUD_115200
            help
                Initial sync always runs at 9600 bps and steps up to this ceiling.

            config OPENLNK_CLIENT_MAX_BAUD_9600
                bool "9600 bps"
            config OPENLNK_CLIENT_MAX_BAUD_19200
                bool "19200 bps"
            config OPENLNK_CLIENT_MAX_BAUD_38400
                bool "38400 bps"
            config OPENLNK_CLIENT_MAX_BAUD_57600
                bool "57600 bps"
            config OPENLNK_CLIENT_MAX_BAUD_115200
                bool "115200 bps"
        endchoice

        config OPENLNK_CLIENT_ECHO_PACED_RX
            bool "Require byte-by-byte echo pacing on RX (recommended)"
            default y
            help
                Sets local_requires_echo = true so 3-wire RS-232 links remain
                reliable at up to 115200 bps without hardware flow control.

        config OPENLNK_CLIENT_FORCE_TX_ECHO
            bool "Force TX echo pacing (for vintage 8250/XT INTERSVR without /V)"
            default n
            help
                Sets cli.link.peer_echo_forced = true immediately after connect.
                Enable when talking to 8250/XT MS-DOS INTERSVR.EXE instances that
                drop burst frames without /V.

        config OPENLNK_CLIENT_KEEPALIVE_MS
            int "Background keepalive interval (ms, 0 = disabled)"
            range 0 5000
            default 200
            help
                Sends idle keepalive pings only when no VFS RPC has occurred for
                this many milliseconds, keeping INTERSVR.EXE / opensvr alive.
    endmenu

    menu "Remote MS-DOS Drive & VFS Mount (/dos)"
        config OPENLNK_CLIENT_MOUNT_POINT
            string "POSIX VFS mount path"
            default "/dos"
            help
                Mount point exposed via ESP-IDF FatFs VFS (must start with '/').

        config OPENLNK_CLIENT_REMOTE_UNIT
            int "Remote server drive unit (-1 = auto-select, 0=A:, 2=C:, ...)"
            range -1 25
            default -1
            help
                Leave at -1 to automatically mount the first mapped and ready
                remote drive advertised by INTERSVR.EXE / OPENSVR.EXE / opensvr.

        config OPENLNK_CLIENT_READ_ONLY
            bool "Mount remote MS-DOS drive read-only (recommended default)"
            default y
            help
                Protects the vintage PC hard disk from accidental writes by
                returning STA_PROTECT / RES_WRPRT before any write RPC is sent.

        config OPENLNK_CLIENT_WRITE_VERIFY
            bool "Use opcode 0x06 WRITE_VERIFY on writes"
            depends on !OPENLNK_CLIENT_READ_ONLY
            default n
            help
                Requests server-side read-back verification on every sector write.

        config OPENLNK_CLIENT_SAMPLE_FILE
            string "Optional file to read from mounted drive (empty = skip)"
            default "AUTOEXEC.BAT"
            help
                File relative to the mount point to read via standard POSIX
                fopen()/fread() as a live smoke test (e.g. AUTOEXEC.BAT or CONFIG.SYS).

        config OPENLNK_CLIENT_UNMOUNT_ON_DONE
            bool "Unmount /dos and disconnect cleanly after demo listing"
            default n
            help
                When enabled, cleanly unmounts the remote VFS and stops the
                keepalive task after listing /dos and reading the sample file.
                When disabled, stays mounted with background keepalive running.
    endmenu

endmenu
```

## esp32/examples/sd_server_idf/main/Kconfig.projbuild
```kconfig
menu "OpenLNK MS-DOS Server Configuration"

    menu "RS-232 / MAX3232 UART Settings"
        config OPENLNK_UART_PORT
            int "UART port number"
            range 0 2
            default 1
            help
                Hardware UART peripheral wired to the MAX3232 RS-232 transceiver.
                Keep UART0 free for USB console logging.

        config OPENLNK_UART_TX_GPIO
            int "UART TX GPIO (to MAX3232 T1IN)"
            range 0 48
            default 17 if IDF_TARGET_ESP32 || IDF_TARGET_ESP32S2 || IDF_TARGET_ESP32S3
            default 4
            help
                GPIO connected to MAX3232 T1IN (3.3V TTL TX).

        config OPENLNK_UART_RX_GPIO
            int "UART RX GPIO (from MAX3232 R1OUT)"
            range 0 48
            default 16 if IDF_TARGET_ESP32
            default 18 if IDF_TARGET_ESP32S2 || IDF_TARGET_ESP32S3
            default 5
            help
                GPIO connected to MAX3232 R1OUT (3.3V TTL RX).

        config OPENLNK_UART_HW_FLOW_CTRL
            bool "Enable RTS/CTS hardware flow control"
            default n
            help
                Standard MS-DOS INTERLNK uses 3-wire null-modem cabling (TX/RX/GND)
                with in-band echo pacing. Leave disabled unless your MAX3232 and
                PC serial cable wire RTS/CTS.

        config OPENLNK_UART_RTS_GPIO
            int "UART RTS GPIO"
            depends on OPENLNK_UART_HW_FLOW_CTRL
            range -1 48
            default -1

        config OPENLNK_UART_CTS_GPIO
            int "UART CTS GPIO"
            depends on OPENLNK_UART_HW_FLOW_CTRL
            range -1 48
            default -1

        choice OPENLNK_MAX_BAUD_CHOICE
            prompt "Maximum negotiated baud rate"
            default OPENLNK_MAX_BAUD_115200
            help
                Initial sync always runs at 9600 bps and steps up to this ceiling.

            config OPENLNK_MAX_BAUD_9600
                bool "9600 bps"
            config OPENLNK_MAX_BAUD_19200
                bool "19200 bps"
            config OPENLNK_MAX_BAUD_38400
                bool "38400 bps"
            config OPENLNK_MAX_BAUD_57600
                bool "57600 bps"
            config OPENLNK_MAX_BAUD_115200
                bool "115200 bps"
        endchoice

        config OPENLNK_ECHO_PACED_RX
            bool "Require byte-by-byte echo pacing on RX (recommended)"
            default y
            help
                Sets local_requires_echo = true so 3-wire RS-232 links remain
                reliable at up to 115200 bps without hardware flow control.

        config OPENLNK_IDLE_DISCONNECT_MS
            int "Idle high-baud disconnect timeout (ms, 0 = disabled)"
            range 0 60000
            default 3000
            help
                Drop back to 9600 bps Phase A sync wait if no keepalives or RPCs
                arrive while connected above 9600 bps.
    endmenu

    menu "SD Card Bus & Storage Mode"
        choice OPENLNK_SD_BUS_CHOICE
            prompt "SD card hardware bus"
            default OPENLNK_SD_BUS_SDMMC if SOC_SDMMC_HOST_SUPPORTED
            default OPENLNK_SD_BUS_SDSPI

            config OPENLNK_SD_BUS_SDMMC
                bool "SDMMC (1-bit / 4-bit native host)"
                depends on SOC_SDMMC_HOST_SUPPORTED

            config OPENLNK_SD_BUS_SDSPI
                bool "SDSPI (SPI host — all ESP32 variants)"
        endchoice

        config OPENLNK_SDMMC_4BIT
            bool "Use 4-bit SDMMC bus (requires external pull-ups on D0..D3)"
            depends on OPENLNK_SD_BUS_SDMMC
            default n

        config OPENLNK_SDMMC_CLK_GPIO
            int "SDMMC CLK GPIO (-1 = default)"
            depends on OPENLNK_SD_BUS_SDMMC && SOC_SDMMC_USE_GPIO_MATRIX
            range -1 48
            default 36

        config OPENLNK_SDMMC_CMD_GPIO
            int "SDMMC CMD GPIO (-1 = default)"
            depends on OPENLNK_SD_BUS_SDMMC && SOC_SDMMC_USE_GPIO_MATRIX
            range -1 48
            default 35

        config OPENLNK_SDMMC_D0_GPIO
            int "SDMMC D0 GPIO (-1 = default)"
            depends on OPENLNK_SD_BUS_SDMMC && SOC_SDMMC_USE_GPIO_MATRIX
            range -1 48
            default 37

        config OPENLNK_SDMMC_D1_GPIO
            int "SDMMC D1 GPIO (-1 = default)"
            depends on OPENLNK_SD_BUS_SDMMC && SOC_SDMMC_USE_GPIO_MATRIX && OPENLNK_SDMMC_4BIT
            range -1 48
            default 38

        config OPENLNK_SDMMC_D2_GPIO
            int "SDMMC D2 GPIO (-1 = default)"
            depends on OPENLNK_SD_BUS_SDMMC && SOC_SDMMC_USE_GPIO_MATRIX && OPENLNK_SDMMC_4BIT
            range -1 48
            default 33

        config OPENLNK_SDMMC_D3_GPIO
            int "SDMMC D3 GPIO (-1 = default)"
            depends on OPENLNK_SD_BUS_SDMMC && SOC_SDMMC_USE_GPIO_MATRIX && OPENLNK_SDMMC_4BIT
            range -1 48
            default 34

        config OPENLNK_SDSPI_MOSI_GPIO
            int "SDSPI MOSI GPIO"
            depends on OPENLNK_SD_BUS_SDSPI
            range 0 48
            default 23 if IDF_TARGET_ESP32
            default 11 if IDF_TARGET_ESP32S2 || IDF_TARGET_ESP32S3
            default 7

        config OPENLNK_SDSPI_MISO_GPIO
            int "SDSPI MISO GPIO"
            depends on OPENLNK_SD_BUS_SDSPI
            range 0 48
            default 19 if IDF_TARGET_ESP32
            default 13 if IDF_TARGET_ESP32S2 || IDF_TARGET_ESP32S3
            default 2

        config OPENLNK_SDSPI_CLK_GPIO
            int "SDSPI CLK GPIO"
            depends on OPENLNK_SD_BUS_SDSPI
            range 0 48
            default 18 if IDF_TARGET_ESP32
            default 12 if IDF_TARGET_ESP32S2 || IDF_TARGET_ESP32S3
            default 6

        config OPENLNK_SDSPI_CS_GPIO
            int "SDSPI CS GPIO"
            depends on OPENLNK_SD_BUS_SDSPI
            range 0 48
            default 5 if IDF_TARGET_ESP32
            default 10

        choice OPENLNK_STORAGE_MODE_CHOICE
            prompt "Storage backend mode"
            default OPENLNK_STORAGE_MODE_RAW

            config OPENLNK_STORAGE_MODE_RAW
                bool "Raw SD card FAT12/FAT16 block device (zero VFS overhead)"

            config OPENLNK_STORAGE_MODE_IMG
                bool "Disk image file (.img / Fixed .vhd) on FAT32/exFAT SD card"
        endchoice

        config OPENLNK_RAW_PARTITION_INDEX
            int "MBR partition index (-1 = auto-detect superfloppy or first FAT12/16)"
            depends on OPENLNK_STORAGE_MODE_RAW
            range -1 3
            default -1

        config OPENLNK_RAW_CD_GPIO
            int "Optional SD card-detect GPIO (-1 = disabled)"
            depends on OPENLNK_STORAGE_MODE_RAW
            range -1 48
            default -1

        config OPENLNK_IMG_FILE_PATH
            string "Disk image file path on mounted SD card"
            depends on OPENLNK_STORAGE_MODE_IMG
            default "/sdcard/dos_c.vhd"

        config OPENLNK_DRIVE_UNIT
            int "Server drive unit index (0=A:, 1=B:, 2=C:, ...)"
            range 0 25
            default 2

        config OPENLNK_READ_ONLY
            bool "Expose drive as write-protected (returns DOS 0x8100 on writes)"
            default n
    endmenu

endmenu
```
